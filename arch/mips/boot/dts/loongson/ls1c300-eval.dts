// SPDX-License-Identifier: GPL-2.0
/dts-v1/;

/include/ "loongson32-ls1c300.dtsi"

/ {
	model = "Loongson LS1C300 evaluation board";
	compatible = "loongson,ls1c300-eval-board", "loongson,ls1c300-soc";

	osc: oscillator {
		compatible = "fixed-clock";
		clock-frequency = <24000000>;
	};

        sdram: memory@0 {
                reg = <0x00000000 0x4000000>;
        };

	chosen {
		bootargs = "console=ttyS2,115200n8 root=/dev/ram0 rw mem=64m init=linuxrc";
	};
};
